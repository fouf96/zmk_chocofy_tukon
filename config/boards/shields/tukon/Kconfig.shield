## config/boards/shields/tukon/Kconfig.shield
```kconfig
config SHIELD_TUKON_LEFT
    def_bool $(shields_list_contains,tukon_left)

config SHIELD_TUKON_RIGHT
    def_bool $(shields_list_contains,tukon_right)
```

## config/tukon_phind/Kconfig.defconfig
```kconfig
if tukon_left

config ZMK_KEYBOARD_NAME
    default "tukonL"

if tukon_right

config ZMK_KEYBOARD_NAME
    default "tukonR"

endif
```

## config/tukon_phind/Kconfig.shield
```kconfig
# The Kconfig.shield file defines any additional Kconfig settings that may
# be relevant when using this keyboard. For most keyboards, there is just
# one additional configuration value for the shield itself

config tukon_left
    def_bool $(shields_list_contains, tukon_left)

config tukon_right
    def_bool $(shields_list_contains, tukon_right)
    
# This will make sure that a new configuration value named
# SHIELD_MY_BOARD is set to true whenever my_board is used as the shield
# name, either as the SHIELD variable in a local build or in your
# build.yaml file when using Github Actions.
```

## config/west.yml
```yaml
manifest:
  remotes:
    - name: petejohanson
      url-base: https://github.com/petejohanson
  projects:
    - name: zmk
      remote: petejohanson
      revision: v3.5-device-power-management
      import: app/west.yml
  self:
    path: config
```
